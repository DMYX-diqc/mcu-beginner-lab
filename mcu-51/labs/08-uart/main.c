/*********************************************************************************************************
* 模块名称: Main.c
* 摘    要: 主文件，包含初始化函数和main函数
* 当前版本: 1.0.0
* 作    者: Leyutek(COPYRIGHT 2018 - 2021 Leyutek. All rights reserved.)
* 完成日期: 2022年2月1日
* 内    容: 
* 注    意: 
**********************************************************************************************************
* 取代版本: 
* 作    者: 
* 完成日期: 
* 修改内容: 
* 修改文件: 
*********************************************************************************************************/
/*********************************************************************************************************
*                                              包含头文件
*********************************************************************************************************/
#include <reg52.h>

/*********************************************************************************************************
*                                              宏定义
*********************************************************************************************************/

/*********************************************************************************************************
*                                              枚举结构体定义
*********************************************************************************************************/

/*********************************************************************************************************
*                                              内部变量
*********************************************************************************************************/

/*********************************************************************************************************
*                                              内部函数声明
*********************************************************************************************************/
static void InitInterrupt(void);
static void InitUART(void);

/*********************************************************************************************************
*                                              内部函数实现
*********************************************************************************************************/
/*********************************************************************************************************
* 函数名称: InitInterrupt
* 函数功能: 中断初始化
* 输入参数: void
* 输出参数: void
* 返 回 值: void
* 创建日期: 2022年2月1日
* 注    意: 
*********************************************************************************************************/
static void InitInterrupt()
{     
  ES = 1;         //打开 串口接受中断允许
  EA = 1;         //打开 总中断允许
}

/*********************************************************************************************************
* 函数名称: InitUART
* 函数功能: 串口初始化
* 输入参数: void
* 输出参数: void
* 返 回 值: void
* 创建日期: 2022年2月1日
* 注    意: 
*********************************************************************************************************/
static void InitUART()
{
  SCON = 0X50;           //设置 串口 工作模式1，并打开接收允许
  TMOD = 0X20;           //设置 定时器1 工作模式2（8位自动重装定时器）
  PCON = 0X80;           //设置 波特率加倍
  TL1  = 0XF3;           //设置 定时器1 计数初值，波特率为4800
  TH1  = TL1;            //设置 定时器1重装载值，等于计数初值
  TR1  = 1;              //打开 定时器1
}

/*********************************************************************************************************
* 函数名称: main
* 函数功能: 主函数
* 输入参数: void
* 输出参数: void
* 返 回 值: void
* 创建日期: 2022年2月1日
* 注    意: 
*********************************************************************************************************/

void main()
{
  unsigned char arrString[]="123456789";    //定义需要发送的字符串
  unsigned char i;  
  InitInterrupt();    //初始化中断
  InitUART();         //初始化串口
                 //定义循环变量

                    //定义循环变量

  while (1)
  {
        for(i=0;i<=10;i++)             //发送arrString中的每个字符
    {
      SBUF = arrString[i];
      while(!TI)
      {
      
      }
      TI = 0;
    }

  }
}

/*********************************************************************************************************
* 函数名称: UART_Handler
* 函数功能: 串口中断服务函数
* 输入参数: void
* 输出参数: void
* 返 回 值: void
* 创建日期: 2022年2月1日
* 注    意: 
*********************************************************************************************************/
void UART_Handler() interrupt 4
{
//    unsigned char arrString[]="1";    //定义需要发送的字符串
//    unsigned char i;                  //定义循环变量
//    for(i=0;i<=2;i++)             //发送arrString中的每个字符
//    {
//      SBUF = arrString[i];
//      while(!TI)
//      {
//      
//      }
//      TI = 0;
//    }

}
