/*********************************************************************************************************
* 模块名称: Main.c
* 摘    要: 主文件，包含初始化函数和main函数
* 当前版本: 1.0.0
* 作    者: Leyutek(COPYRIGHT 2018 - 2021 Leyutek. All rights reserved.)
* 完成日期: 2022年2月1日
* 内    容: 
* 注    意: 
**********************************************************************************************************
* 取代版本: 
* 作    者: 
* 完成日期: 
* 修改内容: 
* 修改文件: 
*********************************************************************************************************/
/*********************************************************************************************************
*                                              包含头文件
*********************************************************************************************************/
#include <reg52.h>

/*********************************************************************************************************
*                                              位定义
*********************************************************************************************************/
sbit BEEP = P1 ^ 0;    //定义蜂鸣器

/*********************************************************************************************************
*                                              特殊功能寄存器定义
*********************************************************************************************************/
sfr WDT_CONTR = 0xE1;  //定义看门狗寄存器

/*********************************************************************************************************
*                                              枚举结构体定义
*********************************************************************************************************/

/*********************************************************************************************************
*                                              内部变量
*********************************************************************************************************/

/*********************************************************************************************************
*                                              内部函数声明
*********************************************************************************************************/
static void DelayNms(int nms);
static void InitInterrupt(void);

/*********************************************************************************************************
*                                              内部函数实现
*********************************************************************************************************/

/*********************************************************************************************************
* 函数名称: DelayNms
* 函数功能: 软件延迟函数，用于延迟一段时间
* 输入参数: xms-延迟时间（毫秒）
* 输出参数: void
* 返 回 值: void
* 创建日期: 2022年2月1日
* 注    意: 
*********************************************************************************************************/
static void DelayNms(int nms)
{
  unsigned int i,j;
  for(i = 0; i < nms; i++)
  {
    for(j = 0; j < 123; j++)
    {
      
    }
  }
}

/*********************************************************************************************************
* 函数名称: InitInterrupt
* 函数功能: 配置中断
* 输入参数: void
* 输出参数: void
* 返 回 值: void
* 创建日期: 2022年2月1日
* 注    意: 
*********************************************************************************************************/
static void InitInterrupt()
{
  IT0 = 1;   //设置 外部中断0 触发方式为下降沿触发
  EX0 = 1;   //打开 定时器0 中断允许
  EA  = 1;   //打开 总中断允许
}

/*********************************************************************************************************
* 函数名称: main
* 函数功能: 主函数
* 输入参数: void
* 输出参数: void
* 返 回 值: void
* 创建日期: 2022年2月1日
* 注    意: 
*********************************************************************************************************/
void main()
{
  unsigned char i;        //定义循环计数变量i
   
  BEEP = 0;               //打开蜂鸣器
  DelayNms(100);          //延时100ms，让蜂鸣器短暂鸣叫
  BEEP = 1;               //关闭蜂鸣器

  InitInterrupt();        //初始化中断
  WDT_CONTR = 0x33;       //设置 看门狗溢出时间为524.2ms
  while (1)
  {
    //流水灯
    P2 = 0xEF;              //点亮LED1
    for(i = 0; i < 4; i++)
    {
      DelayNms(500);        //延时500ms
      P2 = P2 << 1;         //左移一位
      WDT_CONTR |= 0x10;    //喂狗操作
    }
  }
}

/*********************************************************************************************************
* 函数名称: External0_Handler
* 函数功能: 外部中断0中断服务函数
* 输入参数: void
* 输出参数: void
* 返 回 值: void
* 创建日期: 2022年2月1日
* 注    意: 
*********************************************************************************************************/
void External0_Handler() interrupt 0 
{
  DelayNms(2000);        //模拟单片机因外部干扰而卡机
}
