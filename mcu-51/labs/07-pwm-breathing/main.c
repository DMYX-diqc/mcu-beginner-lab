/*********************************************************************************************************
* 模块名称: Main.c
* 摘    要: 主文件，包含初始化函数和main函数
* 当前版本: 1.0.0
* 作    者: Leyutek(COPYRIGHT 2018 - 2021 Leyutek. All rights reserved.)
* 完成日期: 2022年2月1日
* 内    容: 
* 注    意: 
**********************************************************************************************************
* 取代版本: 
* 作    者: 
* 完成日期: 
* 修改内容: 
* 修改文件: 
*********************************************************************************************************/
/*********************************************************************************************************
*                                              包含头文件
*********************************************************************************************************/
#include <reg52.h>

/*********************************************************************************************************
*                                              位定义
*********************************************************************************************************/
sbit LED1 = P2^4; //定义LED1

/*********************************************************************************************************
*                                              宏定义
*********************************************************************************************************/

/*********************************************************************************************************
*                                              枚举结构体定义
*********************************************************************************************************/

/*********************************************************************************************************
*                                              内部变量
*********************************************************************************************************/

/*********************************************************************************************************
*                                              内部函数声明
*********************************************************************************************************/
static void InitInterrupt(void);
static void InitTimer0(void);

/*********************************************************************************************************
*                                              内部函数实现
*********************************************************************************************************/

/*********************************************************************************************************
* 函数名称: InitInterrupt
* 函数功能: 配置定时器0中断
* 输入参数: void
* 输出参数: void
* 返 回 值: void
* 创建日期: 2022年2月1日
* 注    意: 
*********************************************************************************************************/
static void InitInterrupt()
{
  ET0 = 1;   //打开 定时器0 中断允许
  EA  = 1;   //打开 总中断允许
}

/*********************************************************************************************************
* 函数名称: InitInterrupt
* 函数功能: 配置定时器0
* 输入参数: void
* 输出参数: void
* 返 回 值: void
* 创建日期: 2022年2月1日
* 注    意: 
*********************************************************************************************************/
static void InitTimer0()
{
  TMOD = 0x02;  //设置 定时器0 工作方式2(8位自动重装)
  TH0  = 0x9C;  //设置 定时器0 重装值
  TL0  = 0x9C;  //设置 定时器0 计数初值，定时时间100μs
  TR0  = 1;     //打开 定时器0
}

/*********************************************************************************************************
* 函数名称: main
* 函数功能: 主函数
* 输入参数: void
* 输出参数: void
* 返 回 值: void
* 创建日期: 2022年2月1日
* 注    意: 
*********************************************************************************************************/
void main()
{
  InitInterrupt();  //配置中断
  InitTimer0();     //配置定时器0
  while (1)
  {

  }
}

/*********************************************************************************************************
* 函数名称: Timer0_Handler
* 函数功能: 定时器0中断服务函数
* 输入参数: void
* 输出参数: void
* 返 回 值: void
* 创建日期: 2022年2月1日
* 注    意: 
*********************************************************************************************************/
void Timer0_Handler () interrupt 1
{
  static unsigned int s_iCnt1 = 0;        //定义静态变量s_iCnt1作为10ms计数变量，用于控制PWM周期
  static unsigned int s_iCnt2 = 0;        //定义静态变量s_iCnt1作为20ms计数变量，用于控制呼吸快慢
  static unsigned int s_iDuty = 100;      //定义静态变量s_iDuty作为占空比
  static unsigned char s_iFlag = 0;       //定义静态变量s_iFlag作为占空比减小或增加的标志，为0时占空比减小，为1时增加
  
  s_iCnt1++;
  if(s_iCnt1 >= 100)       //PWM周期控制，周期为100*100us=10ms
  {
    s_iCnt1 = 0;           //清零10ms计数变量
  }
  
  s_iCnt2++;
  if(s_iCnt2 >= 200)       //调节占空比，周期为200*100μs=20ms，用于控制呼吸快慢
  {
    s_iCnt2 = 0;           //清零20ms计数变量

    //设置占空比调节标志
    if(s_iDuty >= 100 && 1 == s_iFlag)     //若占空比增大到100且当前标志为增加占空比
    {
      s_iFlag = 0;                         //设置标志为减小占空比
    } 
    else if(0 == s_iDuty && 0 == s_iFlag)  //若占空比减小到0且当前标志为减小占空比
    {
      s_iFlag = 1;                         //设置标志为增加占空比
    }

    //占空比调节
    if(0 == s_iFlag) 	     //若s_iFlag为0
    {
      s_iDuty--;           //减小占空比
    }
    else if(1 == s_iFlag)  //若s_iFlag为1
    {
      s_iDuty++;           //增加占空比
    }
  }

  if(s_iCnt1 <= s_iDuty)   //控制LED的打开与关闭
  {
    LED1 = 1;              //P2.4引脚输出高电平，关闭LED1
  }
  else
  { 
    LED1 = 0;              //P2.4引脚输出低电平，打开LED1
  }
}
