/*********************************************************************************************************
* 模块名称: Main.c
* 摘    要: 主文件，包含初始化函数和main函数
* 当前版本: 1.0.0
* 作    者: Leyutek(COPYRIGHT 2018 - 2021 Leyutek. All rights reserved.)
* 完成日期: 2022年2月1日
* 内    容: 
* 注    意: 
**********************************************************************************************************
* 取代版本: 
* 作    者: 
* 完成日期: 
* 修改内容: 
* 修改文件: 
*********************************************************************************************************/
/*********************************************************************************************************
*                                              包含头文件
*********************************************************************************************************/
#include <reg52.h>

/*********************************************************************************************************
*                                              宏定义
*********************************************************************************************************/
sbit SegmentG1=P2^0;
sbit SegmentG2=P2^1;
sbit SegmentG3=P2^2;
sbit SegmentG4=P2^3;
sbit LED1=P2^4;
sbit LED2=P2^5;
sbit LED3=P2^6;
sbit LED4=P2^7;
sbit BEEP=P1^0;
sbit KEY1 = P3^2; //定义按键KEY1
sbit KEY2 = P3^3; //定义按键KEY2
sbit KEY3=P3^4;
sbit Beep=P1^0;

/*********************************************************************************************************
*                                              枚举结构体定义
*********************************************************************************************************/

/*********************************************************************************************************
*                                              内部变量
*********************************************************************************************************/
static unsigned char s_arrNumber[]={0x03,0x9f,0x25,0x0d,0x99,0x49,0x41,0x1f,0x01,0x09};//定义数码管显示数字0-9

/*********************************************************************************************************
*                                              内部函数声明
*********************************************************************************************************/
static void Delayms(int nms);
static void InitInterrupt(void);
static void SegmentDisplay(char a, char b, char c, char d);

/*********************************************************************************************************
*                                              内部函数实现
*********************************************************************************************************/
/*********************************************************************************************************
* 函数名称: DelayNms
* 函数功能: 软件延迟函数，用于延迟一段时间
* 输入参数: xms-延迟时间（毫秒）
* 输出参数: void
* 返 回 值: void
* 创建日期: 2022年2月1日
* 注    意: 
*********************************************************************************************************/
static void DelayNms(int nms)
{
	unsigned int i,j;
  for(i = 0; i < nms; i++)
	{
    for(j = 0; j < 123; j++);  
  }
}

/*********************************************************************************************************
* 函数名称: SegmentDisplay
* 函数功能: 数码管显示
* 输入参数: a-数码管1显示数字 b-数码管2显示数字 c-数码管3显示数字 d-数码管4显示数字
* 输出参数: void
* 返 回 值: void
* 创建日期: 2022年2月1日
* 注    意: 
*********************************************************************************************************/
static void SegmentDisplay(char a, char b, char c, char d)
{
  P0 = s_arrNumber[a]; //数码管显示数字
  SegmentG1 = 0;       //打开数码管1
  DelayNms(1);         //延迟1ms
  SegmentG1 = 1;       //关闭数码管1

  P0 = s_arrNumber[b]; //数码管显示数字
  SegmentG2 = 0;       //打开数码管2
  DelayNms(1);         //延迟1ms
  SegmentG2 = 1;       //关闭数码管2

  P0 = s_arrNumber[c]; //数码管显示数字
  SegmentG3 = 0;       //打开数码管3
  DelayNms(1);         //延迟1ms
  SegmentG3 = 1;       //关闭数码管3

  P0 = s_arrNumber[d]; //数码管显示数字
  SegmentG4 = 0;       //打开数码管4
  DelayNms(1);         //延迟1ms
  SegmentG4 = 1;       //关闭数码管4
}

/*********************************************************************************************************
* 函数名称: main
* 函数功能: 主函数
* 输入参数: void
* 输出参数: void
* 返 回 值: void
* 创建日期: 2022年2月1日
* 注    意: 
*********************************************************************************************************/
void main()
{	 
	LED1=0;
	LED2=0;
	LED3=0;
	LED4=0;
	SegmentG1=0;
	SegmentG2=0;
	SegmentG3=0;
	SegmentG4=0;
	Beep=0;
  while (1)
  {
	  SegmentDisplay();
  }
