/*********************************************************************************************************
* 模块名称：Flash.c
* 摘    要：Flash模块
* 当前版本：1.0.0
* 作    者：SZLY(COPYRIGHT 2018 - 2020 SZLY. All rights reserved.)
* 完成日期：2020年01月01日   
* 内    容：
* 注    意：                                                                 
**********************************************************************************************************
* 取代版本：
* 作    者：
* 完成日期：
* 修改内容：
* 修改文件：
*********************************************************************************************************/

/*********************************************************************************************************
*                                              包含头文件
*********************************************************************************************************/
#include "Flash.h"
#include "stm32f10x_conf.h"
#include "UART1.h"

/*********************************************************************************************************
*                                              宏定义
*********************************************************************************************************/
//大容量芯片为2K一个PAGE
#define FLASH_PAGE_SIZE ((u16)0x0800)     //十进制为2048

/*********************************************************************************************************
*                                              枚举结构体定义
*********************************************************************************************************/

/*********************************************************************************************************
*                                              内部变量
*********************************************************************************************************/
static u32 s_arrFlashBuf[FLASH_PAGE_SIZE / 4];  //最多是2K字节

/*********************************************************************************************************
*                                              内部函数声明
*********************************************************************************************************/ 
static u32  ReadWord(const u32 addr);   //读取指定地址的字（字，即32位) 
//不检查的写入字（字，即32位)格式的数据 
static void WriteWordNoCheck(const u32 startAddr, u32 *pBuf, u16 numToWrite);  

/*********************************************************************************************************
*                                              内部函数实现
*********************************************************************************************************/
/*********************************************************************************************************
* 函数名称：ReadWord
* 函数功能：读取指定地址的字（字，即32位)
* 输入参数：addr-读地址（此地址为4的倍数）
* 输出参数：void
* 返 回 值：读取到的字格式数据
* 创建日期：2018年01月01日
* 注    意：
*********************************************************************************************************/
static u32 ReadWord(const u32 addr)
{
  return *(vu32*)addr; 
}

/*********************************************************************************************************
* 函数名称：WriteWordNoCheck
* 函数功能：不检查的写入字（字，即32位)格式的数据
* 输入参数：startAddr-起始地址（由于是字（32位）写入，因此，此地址必须为4的倍数）；pBuf-数据指针
*           numToWrite-字（32位）数，即要写入的32位数据的个数
* 输出参数：void
* 返 回 值：void
* 创建日期：2018年01月01日
* 注    意：
*********************************************************************************************************/  
static void WriteWordNoCheck(const u32 startAddr, u32 *pBuf, u16 numToWrite)   
{
  u16 i;
  u32 addr;

  addr = startAddr;     //将起始地址赋给addr，addr在Flash进行写的时候递增

  for(i = 0; i < numToWrite; i++)
  {
    FLASH_ProgramWord(addr, pBuf[i]);
    addr += 4;          //由于是字（32位），故地址增加4
  }  
}

/*********************************************************************************************************
*                                              API函数实现
*********************************************************************************************************/
/*********************************************************************************************************
* 函数名称：InitFlash
* 函数功能：初始化Flash模块
* 输入参数：void
* 输出参数：void
* 返 回 值：void
* 创建日期：2018年01月01日
* 注    意：
*********************************************************************************************************/
void InitFlash(void)
{
  
}

/*********************************************************************************************************
* 函数名称：STM32FlashWriteWord
* 函数功能：从指定地址开始写入指定长度的数据
* 输入参数：startAddr-起始地址（由于是字（32位）读取，因此，此地址必须为4的倍数）；pBuf-数据指针
*           numToWrite-字（32位）数，即要写入的32位数据的个数
* 输出参数：void
* 返 回 值：void
* 创建日期：2018年01月01日
* 注    意：
*********************************************************************************************************/
void  STM32FlashWriteWord(const u32 startAddr, u32* pBuf, u16 numToWrite)
{
  u16 i;    
  u32 pagePos;              //扇区地址，即起始地址startAddr所在的扇区地址
  u16 pageOff;              //扇区内偏移地址（32位计算），即起始地址startAddr所在的扇区的偏移地址
  u16 pageResidue;          //扇区内剩余空间大小（32位计算） 
  u32 offAddr;              //去掉0x08000000后的地址
  u32 addr;                 //写地址，字（32位）为单位
  u16 numToWriteResidue;    //待写入的字（32位）的剩余数
  
  addr = startAddr;         //将起始地址赋给addr，addr在Flash进行写的时候递增
  numToWriteResidue = numToWrite;   //numToWrite是形参，将其复制给动态改变的numToWriteResidue
  
  if(addr < STM32_FLASH_BASE || (addr >= (STM32_FLASH_BASE + 1024 * 256 - 4)))
  {
    printf("error\r\n");
    return;           //如果起始地址小于Flash的基地址，或起始地址超过Flash的范围，即为非法地址，直接退出
  }
  
  FLASH_Unlock();     //解锁
  
  offAddr     = addr - STM32_FLASH_BASE;          //实际偏移地址，即起始地址startAddr在Flash中的偏移地址
  pagePos     = offAddr / FLASH_PAGE_SIZE;        //数据所在的页码
  pageOff     = (offAddr % FLASH_PAGE_SIZE) / 4;  //在扇区内的偏移地址（32位计算）
  pageResidue = FLASH_PAGE_SIZE / 4 - pageOff;    //扇区内剩余空间大小（32位计算）   
  
  if(numToWriteResidue <= pageResidue)            //如果需要写入的字数不大于该扇区剩余空间大小
  {
    pageResidue = numToWriteResidue;              //直接将需要写入的字数大小赋给页剩余空间大小
  }

  while(1) 
  {
    //读出整个扇区的内容
    STM32FlashReadWord(pagePos * FLASH_PAGE_SIZE + STM32_FLASH_BASE, s_arrFlashBuf, FLASH_PAGE_SIZE / 4);

    for(i = 0; i < pageResidue; i++)              //校验数据
    {
      if(s_arrFlashBuf[pageOff + i] != 0xFFFFFFFF)//判断待写入的区域是否已经被擦除，为0xFFFFFFFF则已经被擦除
      {
        break;                                    //如果待写入的区域有数据，需要擦除，则跳出for循环  
      }
    }
    
    if(i < pageResidue)                           //待写入的区域有数据，需要擦除
    {
      FLASH_ErasePage(pagePos * FLASH_PAGE_SIZE + STM32_FLASH_BASE);  //擦除这个扇区
      
      for(i = 0; i < pageResidue; i++)            //将需要写入的数据复制到缓冲区中，起始地址之前的保持不变
      {
        s_arrFlashBuf[pageOff + i] = pBuf[i];
      }
      
      //写入整个扇区
      WriteWordNoCheck(pagePos * FLASH_PAGE_SIZE + STM32_FLASH_BASE, s_arrFlashBuf, FLASH_PAGE_SIZE / 4);  
    }
    else 
    {
      WriteWordNoCheck(addr, pBuf, pageResidue);  //待写入区域已经被擦除，直接写入扇区剩余区间
    }
    
    if(numToWriteResidue == pageResidue)
    {
      break;                        //表示写入已经结束 
    }      
    else                            //表示写入尚未结束
    {
      pagePos++;                    //扇区地址增1，即转移到相邻的下一个扇区
      pageOff = 0;                  //偏移位置为0
      pBuf += pageResidue;          //指针偏移，字（32位）为单位
      addr += pageResidue * 4;      //扇区内写地址，即转移到相邻的下一个扇区的起始地址，字（32位）为单位
      numToWriteResidue -= pageResidue;               //减去已经写入的字数

      if(numToWriteResidue > (FLASH_PAGE_SIZE / 4))   //除以4是因为是以字（32位）为单位
      {
        pageResidue = FLASH_PAGE_SIZE / 4;            //下一个扇区还是写不完
      }
      else 
      {
        pageResidue = numToWriteResidue;              //下一个扇区可以写完了
      }
    } 
  }
  
  FLASH_Lock();                                       //上锁
}

/*********************************************************************************************************
* 函数名称：STM32FlashReadWord
* 函数功能：从指定地址开始读出指定长度的数据
* 输入参数：startAddr-起始地址（由于是字（32位）读取，因此，此地址必须为4的倍数）；pBuf-数据指针
*           numToRead-字（32位）数，即要读取的32位数据的个数
* 输出参数：void
* 返 回 值：void
* 创建日期：2018年01月01日
* 注    意：
*********************************************************************************************************/
void  STM32FlashReadWord(const u32 startAddr, u32* pBuf, u16 numToRead)
{
  u16 i;
  u32 addr;

  addr = startAddr;               //将起始地址赋给addr，addr在Flash进行写的时候递增
  
  for(i = 0; i < numToRead; i++)
  {
    pBuf[i] = ReadWord(addr);     //读取字（32位）
    addr += 4;                    //由于是字（32位），故地址增加4
  }
}
