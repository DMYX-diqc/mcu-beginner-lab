/*********************************************************************************************************
* 模块名称: App.c
* 摘    要: 测试模拟主机命令发送和数据接收
* 当前版本: 1.0.0
* 作    者: Leyutek(COPYRIGHT 2018 - 2021 Leyutek. All rights reserved.)
* 完成日期: 2021年03月01日  
* 内    容:
* 注    意:                                                                   
**********************************************************************************************************
* 取代版本: 
* 作    者:
* 完成日期: 
* 修改内容:
* 修改文件: 
*********************************************************************************************************/

/*********************************************************************************************************
*                                              包含头文件
*********************************************************************************************************/
#include <stdio.h>
#include <windows.h>
#pragma comment(lib, "winmm.lib")    //导入winmm.lib多媒体库

#include "PackUnpack.h"
#include "ProcMCUData.h"
#include "SendCmdToMCU.h"

/*********************************************************************************************************
*                                              宏定义
*********************************************************************************************************/

/*********************************************************************************************************
*                                              枚举结构体定义
*********************************************************************************************************/

/*********************************************************************************************************
*                                              内部变量
*********************************************************************************************************/

/*********************************************************************************************************
*                                              内部函数声明
*********************************************************************************************************/
static  void  InitSoftware(void);     //初始化Software

static void __stdcall TimeProc(unsigned int uTimerID, unsigned int uMsg, unsigned long dwUser, 
                               unsigned long dw1, unsigned long dw2);

static  void  Proc2msTask(void);        //声明一个2ms执行一次的函数
static  void  Proc20msTask(void);       //声明一个20ms执行一次的函数
static  void  Proc1SecTask(void);       //声明一个1sec执行一次的函数

/*********************************************************************************************************
*                                              内部函数实现
*********************************************************************************************************/
/*********************************************************************************************************
* 函数名称: InitSoftware
* 函数功能: 所有的软件初始化函数都放在此函数中
* 输入参数: void
* 输出参数: void
* 返 回 值: void
* 创建日期: 2021年03月01日
* 注    意: 
*********************************************************************************************************/
static  void  InitSoftware(void)
{
  InitPackUnpack();
  InitProcMCUData();
  InitSendCmdToMCU();
}

/*********************************************************************************************************
* 函数名称: TimeProc
* 函数功能: 定时器回调函数
* 输入参数: *
* 输出参数: void
* 返 回 值: void
* 创建日期: 2021年03月01日
* 注    意: 
*********************************************************************************************************/
static void __stdcall TimeProc(unsigned int uTimerID, unsigned int uMsg, unsigned long dwUser, 
  unsigned long dw1, unsigned long dw2)
{
  Proc2msTask();
}

/*********************************************************************************************************
* 函数名称: Proc2msTask
* 函数功能: 处理2ms任务 
* 输入参数: void
* 输出参数: void
* 返 回 值: void
* 创建日期: 2021年03月01日
* 注    意: 
*********************************************************************************************************/
static  void  Proc2msTask(void)
{
  static  i16 s_iCnt500 = 0;
  static  i16 s_iCnt10  = 0;

  if(s_iCnt10 >= 9)
  {
    Proc20msTask();
    s_iCnt10 = 0;
  }
  else
  {
    s_iCnt10++;
  }
  
  if(s_iCnt500 >= 499)
  {
    Proc1SecTask();
    s_iCnt500 = 0;
  }
  else
  {
    s_iCnt500++;
  }
}

/*********************************************************************************************************
* 函数名称: Proc20msTask
* 函数功能: 处理20ms任务 
* 输入参数: void
* 输出参数: void
* 返 回 值: void
* 创建日期: 2021年03月01日
* 注    意: 
*********************************************************************************************************/
static  void  Proc20msTask(void)
{
  static  i16 s_iCnt = 0;

  //模拟接收到的MCU数据，包含两个波形数据包
  static  u8  s_arrRecMCUData[20] = {0x70, 0xa0, 0x82, 0x92, 0xb4, 0xd6, 0xf8, 0x90, 0x80, 0xb6, 
                                     0x71, 0xa0, 0x82, 0x91, 0xb3, 0xd5, 0xf7, 0x99, 0x80, 0xbc};

  //每隔20ms处理一次从机数据，即对接收到的数据进行解包处理
  ProcMCUData(s_arrRecMCUData[s_iCnt]);
  
  //以下的循环计数是为了循环处理s_arrRecMCUData中的数据
  if(s_iCnt >= 19)
  {
    s_iCnt = 0;
  }
  else
  {
    s_iCnt++;
  }  
}

/*********************************************************************************************************
* 函数名称: Proc1SecTask
* 函数功能: 处理1sec任务 
* 输入参数: void
* 输出参数: void
* 返 回 值: void
* 创建日期: 2021年03月01日
* 注    意: 
*********************************************************************************************************/
static  void  Proc1SecTask(void)
{
  printf("Print gen wave1 cmd:");
  SendGenWave1CmdToMCU();
  printf("\n");

  printf("Print gen wave2 cmd:");
  SendGenWave2CmdToMCU();
  printf("\n");
}

/*********************************************************************************************************
*                                              API函数实现
*********************************************************************************************************/
/*********************************************************************************************************
* 函数名称: main
* 函数功能: 主函数
* 输入参数: void 
* 输出参数: void
* 返 回 值: void
* 创建日期: 2021年03月01日
* 注    意: 
*********************************************************************************************************/
void  main(void)
{
  InitSoftware();                 //初始化软件
  
  //timeSetEvent函数说明   
  //MMRESULT timeSetEvent(
  //  UINT           uDelay,        //以毫秒指定事件的周期
  //  UINT           uResolution,   //以毫秒指定延时的精度，数值越小定时器事件分辨率越高，省值为1ms
  //  LPTIMECALLBACK lpTimeProc,    //指向一个回调函数，即单次事件触发时，或者周期性事件触发时调用的函数
  //  DWORD_PTR      dwUser,        //存放用户提供的回调数据
  //  UINT           fuEvent        //指定定时器事件类型，TIME_ONESHOT-单次触发，TIME_PERIODIC-周期性触发
  //);
  
  //用户定时器设定，定时器精度为1ms，每隔2ms触发一次定时器，并执行回调函数TimeProc
  timeSetEvent(2, 1, TimeProc, 0, TIME_PERIODIC);
  
  while(1)
  {    
  }  
}
