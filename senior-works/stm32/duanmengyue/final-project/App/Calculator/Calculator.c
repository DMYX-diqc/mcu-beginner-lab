/*********************************************************************************************************
* 模块名称：Calculator.c
* 摘    要：计算器模块，包括
* 当前版本：1.0.0
* 作    者：DMYX
* 完成日期：2026年07月19日 
* 内    容：
* 注    意：                                                                  
**********************************************************************************************************
* 取代版本：
* 作    者：
* 完成日期：
* 修改内容：
* 修改文件：
*********************************************************************************************************/

/*********************************************************************************************************
*                                              包含头文件
*********************************************************************************************************/
#include "Calculator.h"
#include <string.h>   // memset
#include <ctype.h>    // isdigit
#include <stdio.h>    // printf
#include <math.h> // fabs 浮点绝对值

/*********************************************************************************************************
*                                              内部变量
*********************************************************************************************************/
// ==========================计算器全局状态=============================//
char expr_buf[EXPR_MAX_LEN];  // 存储完整运算式，如"3+9"
uint8_t expr_len = 0;         // 当前表达式有效长度
float calc_result = 0.0f;          // 计算结果(可以是浮点数)
uint8_t flag_has_expr = 0;    // 1=存在有效表达式，0=无
uint8_t flag_calc_done = 0;   // 1=已按下KEY1计算完成
uint8_t calc_err = 0; // 1 = 出现除零错误，0 = 无错误
// ====================== 多运算符四则运算栈 ===========================//

// 数字栈（浮点栈）、运算符栈
float num_stack[STACK_MAX]; //操作数栈
char op_stack[STACK_MAX]; //运算符栈
uint8_t num_top = 0;      //数字栈的栈顶指针
uint8_t op_top = 0;       //运算符栈的栈顶指针

// =========================历史记录环形缓存==========================//
char hist_expr[HIST_REC_MAX][EXPR_MAX_LEN];
float hist_result[HIST_REC_MAX];
uint8_t hist_store_idx = 0;
uint8_t hist_valid_cnt = 0;

// ===========================OLED页面标记===========================//
uint8_t oled_page = 0;
/*********************************************************************************************************
*                                              内部函数声明
*********************************************************************************************************/
static uint8_t GetOpPri(char op);
static void CalcOnce(void);

/*********************************************************************************************************
*                                              内部函数实现
*********************************************************************************************************/
/*********************************************************************************************************
* 函数名称：GetOpPri
* 函数功能：获取运算符优先级
*********************************************************************************************************/
static uint8_t GetOpPri(char op)
{
    if(op == '(') return 0;
    if(op == '+' || op == '-') return 1;
    if(op == '*' || op == '/') return 2;
    return 0;
}

/*********************************************************************************************************
* 函数名称：CalcOnce
* 函数功能：弹出两个数字和一个运算符，计算结果压回数字栈
*********************************************************************************************************/
static void CalcOnce(void)
{
    float b = num_stack[--num_top];
    float a = num_stack[--num_top];
    char op = op_stack[--op_top];
    float res = 0.0f;

    switch(op)
    {
        case '+': res = a + b; break;
        case '-': res = a - b; break;
        case '*': res = a * b; break;
        case '/'://取b的绝对值，1乘以10的-6次方 = 0.000001
            if(fabs(b) < 1e-6f)// 浮点数不能直接==0，极小值判定为0
            {
                printf("错误：除数不能为0！\r\n");
                calc_err = 1;
                return;
            }
            res = a / b; // 向0取整
            break;
        default:return;
    }
    num_stack[num_top++] = res;
}

/*********************************************************************************************************
*                                              API函数实现
*********************************************************************************************************/
/*********************************************************************************************************
* 函数名称：InitCalculator
* 函数功能：清空表达式、重置所有计算器标志，归零
*********************************************************************************************************/
void InitCalculator(void)
{
    //memset()的作用是将一块连续的内存区域，按“字节”为单位，全部填充为同一个指定的值
    //sizeof 会计算出整个数组占用的总字节数，确保数组被完全清空
    //strlen计算的是有效字符的数量（不能完全清空数组）
    memset(expr_buf, 0, sizeof(expr_buf));//清除字符串缓冲区(用0填充)
    expr_len = 0;
    calc_result = 0.0f;//计算结果清零
    flag_has_expr = 0;//无有效表达式
    flag_calc_done = 0;//计算未完成
    calc_err = 0; //错误标记清零
  
    //**********清空栈缓存************//
    num_top = 0;//栈顶指针清零
    op_top = 0;
    memset(num_stack, 0, sizeof(num_stack));
    memset(op_stack, 0, sizeof(op_stack));
    printf("\r\n");
}

/*********************************************************************************************************
* 函数名称：ParseAndCalcExpr
* 函数功能：解析0~9单数字+多运算符表达式，执行四则运算，除法向0取整、除零报错
*********************************************************************************************************/
void ParseAndCalcExpr(void)
{
    uint8_t i;
    // 清空栈、标记
    num_top = 0;
    op_top = 0;
    memset(num_stack, 0, sizeof(num_stack));
    memset(op_stack, 0, sizeof(op_stack));
    flag_calc_done = 0;
    calc_err = 0;

 
  
    for(i = 0; i < expr_len; i++)
    {
        char ch = expr_buf[i];
        // ========== 分支1：数字/小数点，拼接多位数浮点数 ==========
        if( (ch >= '0' && ch <= '9') || ch == '.' )
        {
            uint8_t k;
            float digit;
            uint8_t dot_cnt = 0; // 记录当前数字段小数点个数
            float val = 0.0f;
            float dot_rate = 1.0f; // 小数位缩放系数
            uint8_t j = i;
            

            // 循环截取一整段连续数字+小数点
            while(j < expr_len && ((expr_buf[j] >= '0' && expr_buf[j] <= '9') || expr_buf[j] == '.'))
            {
                if(expr_buf[j] == '.')
                {
                    dot_cnt++;
                    if(dot_cnt > 1) // 一个数字多个小数点，非法
                    {
                        printf("表达式错误：数字包含多个小数点\r\n");
                        return;
                    }
                }
                j++;
            }

            // 从i ~ j-1 解析成浮点数
            for(k = i; k < j; k++)
            {
                if(expr_buf[k] == '.')
                {
                    dot_rate = 0.1f;
                    continue;
                }
                digit = expr_buf[k] - '0';
                if(dot_rate == 1.0f)
                {
                    val = val * 10.0f + digit; // 整数部分
                }
                else
                {
                    val = val + digit * dot_rate; // 小数部分
                    dot_rate *= 0.1f;
                }
            }
            num_stack[num_top++] = val;
            i = j - 1; // 主循环跳过已解析完的数字段
        }
        // ========== 分支2：左括号 ==========
        else if(ch == '(')
        {
            op_stack[op_top++] = ch;
        }
        // ========== 分支3：四则运算符 ==========
        else if(ch == '+' || ch == '-' || ch == '*' || ch == '/')
        {
            while(op_top > 0 && GetOpPri(op_stack[op_top - 1]) >= GetOpPri(ch))
            {
                CalcOnce();
                if(calc_err == 1)
                    return;
            }
            op_stack[op_top++] = ch;
        }
        // ========== 分支4：右括号 ==========
        else if(ch == ')')
        {
            while(op_top > 0 && op_stack[op_top - 1] != '(')
            {
                CalcOnce();
                if(calc_err == 1)
                    return;
            }
            if(op_top == 0)
            {
                printf("表达式错误：括号不匹配，缺少左括号\r\n");
                return;
            }
            op_top--; // 弹出丢弃左括号
        }
        // ========== 分支5：非法字符 ==========
        else
        {
            printf("表达式包含非法字符！仅支持 0~9 . +-*/()\r\n");
            return;
        }
    }

    // 遍历结束，清算剩余运算符
    while(op_top > 0)
    {
        if(op_stack[op_top - 1] == '(')
        {
            printf("表达式错误：括号不匹配，缺少右括号\r\n");
            return;
        }
        CalcOnce();
        if(calc_err == 1)
            return;
    }

    calc_result = num_stack[0];
    flag_calc_done = 1;
    printf("计算完成，按下KEY2发送结果\r\n");
    // 新增：如果计算无错误才保存历史
    if(calc_err == 0)
    {
      SaveCalcHistory();
    }
}

/*********************************************************************************************************
* 函数名称：SaveCalcHistory
* 功能：计算成功后保存当前算式与结果到环形缓存
*********************************************************************************************************/
void SaveCalcHistory(void)
{
    strcpy(hist_expr[hist_store_idx], expr_buf);//将表达式数组里面的表达式复制到历史表达式数组
    hist_result[hist_store_idx] = calc_result;//存储历史计算结果
    hist_store_idx = (hist_store_idx + 1) % HIST_REC_MAX;//写入指针环形后移，这是环形缓存的灵魂
    // // %HIST_REC_MAX确保数组不会越界，到达末尾时，自动回到0
    if(hist_valid_cnt < HIST_REC_MAX)
    {
      hist_valid_cnt++;//有效计数递增
    }
}

